/******************************************************************************
 * 交通灯实验 — 普中A2开发板实物版  (Keil C51)
 *
 * 芯片    : STC89C52RC  @ 11.0592 MHz
 * 编译环境: Keil uVision 5
 *
 *  ╔══════════════════════════════════════════════════════════╗
 *  ║  引脚映射 (普中A2实验板)                                 ║
 *  ║  信号灯: P1口杜邦线外接(6个LED)                         ║
 *  ║    南北红/黄/绿: P1.3 / P1.5 / P1.4                    ║
 *  ║    东西红/黄/绿: P1.0 / P1.2 / P1.1                    ║
 *  ║  紧急按键: P3.2(INT0) — 用板上KEY3                     ║
 *  ║  数码管(共阳极, 74HC138译码):                           ║
 *  ║    段选: P0 (经74HC245缓冲, 低电平有效)                 ║
 *  ║    位选A/B/C: P2.2 / P2.3 / P2.4 → 74HC138            ║
 *  ║    Y0(000)=NS十位  Y1(001)=NS个位                      ║
 *  ║    Y2(010)=EW十位  Y3(011)=EW个位                      ║
 *  ╚══════════════════════════════════════════════════════════╝
 *
 *  ╔══════════════════════════════════════════════════════════╗
 *  ║  跳线帽配置                                             ║
 *  ║  段选: ON    位选: ON                                   ║
 *  ║  JP4(矩阵键盘): ON  (P1用杜邦线外接LED)                 ║
 *  ║  JP8(步进电机): OFF (交通灯不需要电机)                   ║
 *  ╚══════════════════════════════════════════════════════════╝
 *
 *  功能说明:
 *  1. 基础交通灯: 南北通行20s→南北黄闪3s→东西通行15s→东西黄闪3s
 *  2. 紧急中断: KEY3(P3.2)按下→全方向强制红灯→松手恢复
 *  3. 4位数码管: 南北东西各2位显示倒计时
 *
 *  定时器0: 1ms中断, 数码管动态扫描 + 计时
 *  外部中断0: KEY3紧急模式切换
 *
 *  ★与Proteus仿真版的区别:
 *    - 晶振 11.0592MHz (非12MHz)
 *    - 定时器初值 TH0=0xFC, TL0=0x66 (非0xFC18)
 *    - 数码管位选用74HC138译码(P2.2/P2.3/P2.4, 低有效)
 *      (非P2.0~P2.3直连高有效)
 ******************************************************************************/

#include <reg51.h>

/* ======================== 信号灯引脚 ======================== */
/*
 * 6个LED通过杜邦线连接P1口
 * 共阳接法: 0=亮, 1=灭
 * 注意: P1.6/P1.7未使用, 保持默认高电平
 */
sbit NS_RED    = P1^3;   // 南北红灯
sbit NS_YELLOW = P1^5;   // 南北黄灯
sbit NS_GREEN  = P1^4;   // 南北绿灯
sbit EW_RED    = P1^0;   // 东西红灯
sbit EW_YELLOW = P1^2;   // 东西黄灯
sbit EW_GREEN  = P1^1;   // 东西绿灯

/* ======================== 紧急按键 ======================== */
/*
 * KEY3 = P3.2 (INT0), 低电平有效
 * 板载独立按键, 按下时引脚接GND
 */
sbit EMERGENCY_KEY = P3^2;

/* ======================== 数码管 (74HC138译码) ======================== */
/*
 * 位选: P2.2=A, P2.3=B, P2.4=C → 74HC138 → Y0~Y7 (低有效)
 * 段选: P0 → 74HC245 → 共阳极数码管 (低电平有效)
 *
 * 138输入映射:
 *   000(Y0)=NS十位  001(Y1)=NS个位
 *   010(Y2)=EW十位  011(Y3)=EW个位
 */

/* 共阳极数码管段码表 (0~9, 10=全灭) */
/*
 * 共阳极: 该段对应的bit=0时点亮
 * 位: DP G F E D C B A
 * 0xC0=11000000 → a~f亮, g灭 → 显示"0"
 */
unsigned char code seg_table[11] = {
    0xC0, // 0
    0xF9, // 1
    0xA4, // 2
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    0x90, // 9
    0xFF  // 全灭
};

/* 显示缓冲区: [NS十位, NS个位, EW十位, EW个位], 初始全灭 */
volatile unsigned char disp_buf[4] = {10, 10, 10, 10};

/* ======================== 状态机 ======================== */
#define STATE_NS_GO    0    // 南北通行 (绿灯亮, 20秒)
#define STATE_NS_WARN  1    // 南北缓冲 (黄灯闪, 3秒)
#define STATE_EW_GO    2    // 东西通行 (绿灯亮, 15秒)
#define STATE_EW_WARN  3    // 东西缓冲 (黄灯闪, 3秒)

unsigned char current_state = STATE_NS_GO;
unsigned char ns_count = 20;     // 南北倒计时
unsigned char ew_count = 0;      // 东西倒计时

/* ======================== 紧急中断 ======================== */
volatile bit emergency_mode = 0;  // 1=紧急模式, 0=正常模式
bit saved_once = 0;               // 是否已保存现场
unsigned char state_backup;       // 备份的状态
unsigned char ns_backup, ew_backup;  // 备份的倒计时

/* ======================== 计时标志 ======================== */
volatile bit flag_1s = 0;         // 1秒标志
volatile bit flag_500ms = 0;      // 0.5秒标志
volatile bit flag_update_lights = 0;  // 信号灯刷新标志

/* ======================== 延时函数 ======================== */

/*******************************************************************************
 * 函数名  : delay_ms
 * 功能    : 毫秒级延时 (@11.0592MHz)
 * 参数    : ms = 延时的毫秒数
 * 返回值  : 无
 * 说明    : 软件循环, 仅用于按键消抖等非精确场合
 *******************************************************************************/
void delay_ms(unsigned int ms)
{
    unsigned int i, j;
    for (i = 0; i < ms; i++)
        for (j = 0; j < 120; j++);
}

/* ======================== 信号灯控制 ======================== */

/*******************************************************************************
 * 函数名  : update_lights
 * 功能    : 根据当前状态刷新6个信号灯
 * 参数    : 无
 * 返回值  : 无
 * 说明    : 每次调用先全部熄灭, 再按状态点亮对应灯
 *           共阳: 0=亮, 1=灭
 *******************************************************************************/
void update_lights(void)
{
    /* 先全部熄灭 (置1) */
    NS_RED = 1; NS_YELLOW = 1; NS_GREEN = 1;
    EW_RED = 1; EW_YELLOW = 1; EW_GREEN = 1;

    switch (current_state) {

    case STATE_NS_GO:          // 南北通行: 南北绿, 东西红
        NS_GREEN = 0;
        EW_RED = 0;
        break;

    case STATE_NS_WARN:        // 南北缓冲: 南北黄闪, 东西红
        EW_RED = 0;
        /* 黄灯闪烁由 flag_500ms 控制: 0=亮, 1=灭 */
        NS_YELLOW = flag_500ms ? 0 : 1;
        break;

    case STATE_EW_GO:          // 东西通行: 南北红, 东西绿
        NS_RED = 0;
        EW_GREEN = 0;
        break;

    case STATE_EW_WARN:        // 东西缓冲: 南北红, 东西黄闪
        NS_RED = 0;
        EW_YELLOW = flag_500ms ? 0 : 1;
        break;
    }
}

/* ======================== 数码管显示 ======================== */

/*******************************************************************************
 * 函数名  : update_display
 * 功能    : 更新数码管显示缓冲区
 * 参数    : ns = 南北倒计时秒数, ew = 东西倒计时秒数
 * 返回值  : 无
 * 说明    : 拆分为十位和个位存入 disp_buf
 *           若值为0则显示全灭 (倒计时到0时不显示)
 *******************************************************************************/
void update_display(unsigned char ns, unsigned char ew)
{
    if (ns > 0) {
        disp_buf[0] = ns / 10;     // 南北十位
        disp_buf[1] = ns % 10;     // 南北个位
    } else {
        disp_buf[0] = 10;          // 全灭
        disp_buf[1] = 10;
    }
    if (ew > 0) {
        disp_buf[2] = ew / 10;     // 东西十位
        disp_buf[3] = ew % 10;     // 东西个位
    } else {
        disp_buf[2] = 10;
        disp_buf[3] = 10;
    }
}

/* ======================== 初始化 ======================== */

/*******************************************************************************
 * 函数名  : timer0_init
 * 功能    : 定时器0初始化 — 1ms中断
 * 参数    : 无
 * 返回值  : 无
 * 说明    : 模式1(16位), 11.0592MHz
 *           计数值 = 1ms / (12/11.0592MHz) ≈ 922
 *           重装值 = 65536 - 922 = 64614 = 0xFC66
 *******************************************************************************/
void timer0_init(void)
{
    TMOD &= 0xF0;                // 清零T0配置位
    TMOD |= 0x01;                // T0 = 模式1 (16位定时器)
    TH0 = 0xFC;                  // 11.0592MHz: 1ms初值高字节
    TL0 = 0x66;                  // 11.0592MHz: 1ms初值低字节
    ET0 = 1;                     // 使能T0中断
    TR0 = 1;                     // 启动T0
}

/*******************************************************************************
 * 函数名  : ext0_init
 * 功能    : 外部中断0初始化 — KEY3紧急按键
 * 参数    : 无
 * 返回值  : 无
 * 说明    : 下降沿触发, P3.2(INT0)
 *******************************************************************************/
void ext0_init(void)
{
    IT0 = 1;                     // 下降沿触发
    EX0 = 1;                     // 使能外部中断0
}

/* ======================== 主函数 ======================== */

/*******************************************************************************
 * 函数名  : main
 * 功能    : 程序入口
 * 参数    : 无
 * 返回值  : 无
 *
 * 说明    : 初始化顺序: 端口→定时器→外部中断→EA
 *           主循环: 紧急模式处理 + 正常状态机推进
 *******************************************************************************/
void main(void)
{
    /* === 端口初始化 === */
    P0 = 0xFF;                   // 数码管段选全灭
    P1 = 0xFF;                   // 信号灯全灭, 高4位输入模式
    P2 = 0xFF;                   // 位选全高(138→Y7未用), LED灭
    P3 = 0xFF;                   // 按键输入模式

    /* === 定时器0初始化 === */
    timer0_init();

    /* === 外部中断0初始化 === */
    ext0_init();

    /* === 开总中断 === */
    EA = 1;                      // ★所有初始化完成后再开中断

    /* === 初始显示 === */
    update_lights();
    update_display(ns_count, ew_count);

    /* ══════════════════════════════════════════════════
     *  主循环
     * ══════════════════════════════════════════════════ */
    while (1) {

        /* ---------- 紧急模式 ---------- */
        if (emergency_mode) {
            /*
             * 首次进入紧急模式时, 保存当前状态和倒计时到备份变量
             */
            if (!saved_once) {
                state_backup = current_state;
                ns_backup    = ns_count;
                ew_backup    = ew_count;
                saved_once   = 1;
            }

            /* 强制全方向红灯 (0=亮) */
            NS_RED = 0; NS_YELLOW = 1; NS_GREEN = 1;
            EW_RED = 0; EW_YELLOW = 1; EW_GREEN = 1;

            /* 数码管显示中断前的倒计时值(冻结状态) */
            update_display(ns_backup, ew_backup);

            /* KEY3松开 → 退出紧急模式 */
            if (EMERGENCY_KEY == 1) {
                delay_ms(20);        // 消抖
                if (EMERGENCY_KEY == 1) {
                    emergency_mode = 0;
                }
            }
        }

        /* ---------- 正常模式 ---------- */
        else {

            /* 刚从紧急模式恢复 → 还原现场 */
            if (saved_once) {
                current_state  = state_backup;
                ns_count       = ns_backup;
                ew_count       = ew_backup;
                saved_once     = 0;
                update_lights();
                update_display(ns_count, ew_count);
            }

            /* 每0.5秒刷新一次信号灯 (保证黄灯闪烁频率) */
            if (flag_update_lights) {
                flag_update_lights = 0;
                update_lights();
            }

            /* 每秒状态机推进 */
            if (flag_1s) {
                flag_1s = 0;

                switch (current_state) {

                case STATE_NS_GO:          // 南北通行
                    if (ns_count > 0) ns_count--;
                    if (ns_count == 0) {
                        current_state = STATE_NS_WARN;
                        ns_count = 3;       // 黄灯3秒
                        ew_count = 0;
                    }
                    break;

                case STATE_NS_WARN:        // 南北黄闪
                    if (ns_count > 0) ns_count--;
                    if (ns_count == 0) {
                        current_state = STATE_EW_GO;
                        ns_count = 0;
                        ew_count = 15;      // 东西通行15秒
                    }
                    break;

                case STATE_EW_GO:          // 东西通行
                    if (ew_count > 0) ew_count--;
                    if (ew_count == 0) {
                        current_state = STATE_EW_WARN;
                        ns_count = 0;
                        ew_count = 3;       // 黄灯3秒
                    }
                    break;

                case STATE_EW_WARN:        // 东西黄闪
                    if (ew_count > 0) ew_count--;
                    if (ew_count == 0) {
                        current_state = STATE_NS_GO;
                        ns_count = 20;      // 南北通行20秒
                        ew_count = 0;
                    }
                    break;
                }

                /* 更新数码管倒计时显示 */
                update_display(ns_count, ew_count);
            }
        }
    }
}

/* ======================== 定时器0中断 ======================== */

/*******************************************************************************
 * 函数名  : timer0_ISR
 * 功能    : 定时器0中断服务程序 — 每1ms触发
 * 参数    : 无 (中断函数)
 * 返回值  : 无
 *
 * 说明    : 处理两个任务:
 *           (1) 4位数码管动态扫描 (每1ms切换一位)
 *           (2) 计时: 累加1秒标志和0.5秒标志
 *
 *           数码管动态扫描流程:
 *           ① 关闭所有位选 (138输入=111→Y7, 未使用)
 *           ② P0输出当前位的段码
 *           ③ 选中当前位 (138输入=scan_pos 0~3)
 *           ④ scan_pos指向下一位 (0→1→2→3→0循环)
 *
 *           每次ISR只显示一位, 4次ISR完成一轮刷新,
 *           刷新频率 = 1ms × 4 = 4ms ≈ 250Hz, 无闪烁
 *******************************************************************************/
void timer0_ISR(void) interrupt 1
{
    static unsigned char scan_pos = 0;   // 当前扫描位: 0~3
    static unsigned int  ms_count = 0;   // 毫秒累加器
    static unsigned int  half_count = 0; // 半秒累加器

    /* 重装定时器初值 (模式1需手动重装) */
    TH0 = 0xFC;
    TL0 = 0x66;

    /* --- 数码管动态扫描 --- */

    /* 第1步: 关闭所有位选 → 138输入=111(二进制) → Y7(未使用) */
    /* 0x1C = 00011100, 将P2.2/P2.3/P2.4置1 */
    P2 = (P2 & 0xE3) | 0x1C;

    /* 第2步: 输出当前位的段码到P0 */
    P0 = seg_table[disp_buf[scan_pos]];

    /* 第3步: 选中当前位 */
    /* scan_pos=0→000(Y0=NS十位), 1→001(Y1=NS个位),
       2→010(Y2=EW十位), 3→011(Y3=EW个位)          */
    P2 = (P2 & 0xE3) | (scan_pos << 2);

    /* 第4步: 指向下一位 (0→1→2→3→0循环) */
    scan_pos = (scan_pos + 1) & 0x03;

    /* --- 计时控制 --- */
    /* 累加1000次1ms=1秒 */
    if (++ms_count >= 1000) {
        ms_count = 0;
        flag_1s = 1;
    }

    /* 累加500次1ms=0.5秒 (用于黄灯闪烁) */
    if (++half_count >= 500) {
        half_count = 0;
        flag_500ms = ~flag_500ms;         // 翻转0.5秒标志
        flag_update_lights = 1;           // 通知主循环刷新信号灯
    }
}

/* ======================== 外部中断0 (紧急按键) ======================== */

/*******************************************************************************
 * 函数名  : ext0_ISR
 * 功能    : 外部中断0 — KEY3紧急模式切换
 * 参数    : 无 (中断函数)
 * 返回值  : 无
 * 说明    : 每次触发翻转 emergency_mode
 *           已在紧急模式→切回正常
 *           正常模式→进入紧急(全红灯)
 *           注意: 中断中不调用耗时函数, 只置标志
 *******************************************************************************/
void ext0_ISR(void) interrupt 0
{
    if (emergency_mode) {
        emergency_mode = 0;   // 已在紧急模式: 再按一次退出
    } else {
        emergency_mode = 1;   // 正常模式: 进入紧急
    }
}
